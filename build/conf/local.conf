## build/conf/local.conf
```bitbake
MACHINE ??= "raspberrypi0-wifi"
#MACHINE ??= "raspberrypi4-64"
#MACHINE ??= "raspberrypi0-2w-64"
MACHINE_FEATURES:append = " vc4graphics"
DISTRO ?= "poky"
PACKAGE_CLASSES ?= "package_rpm"
EXTRA_IMAGE_FEATURES:append = " read-only-rootfs"
USER_CLASSES ?= "buildstats"
PATCHRESOLVE = "noop"
DISTRO_FEATURES:remove = "acl alsa argp bluetooth irda largefile pcmcia usbgadget usbhost xattr nfs zeroconf pci 3g nfc x11 wayland pulseaudio"
IMAGE_FSTYPES = "rpi-sdimg"
VIRTUAL-RUNTIME_init_manager = "sysvinit"
VIRTUAL-RUNTIME_dev_manager = ""
BOOTDD_VOLUME_ID = "boot"
SERIAL_CONSOLES = ""
SYSVINIT_ENABLED_GETTYS = ""
ENABLE_SPI_BUS = "1"
ENABLE_DWC2_PERIPHERAL = "1"
GPU_MEM = "64"
VC4DTBO = "vc4-fkms-v3d"
CMDLINE:append = " ro quiet consoleblank=0"
KERNEL_MODULE_AUTOLOAD += "gadgetfs dwc2 vc4 v3d"
EXTRA_IMAGECMD:ext3 = "-i 4096 -L fs"
FATPAYLOAD += " ${datadir}/pitrezor/pitrezor.config"
TOOLCHAIN_TARGET_TASK:append = " bcm2835-staticdev"
TOOLCHAIN_HOST_TASK:append = " nativesdk-protobuf-compiler nativesdk-python3-protobuf nativesdk-python3-setuptools nativesdk-python3 nativesdk-python3-click nativesdk-python3-trezor nativesdk-python3-mako nativesdk-python3-munch nativesdk-python3-typing-extensions"
RPI_EXTRA_CONFIG = '\n\
hdmi_safe=1\n\
dtparam=random=on\n\
'

BB_DISKMON_DIRS = "\
    STOPTASKS,${TMPDIR},1G,100K \
    STOPTASKS,${DL_DIR},1G,100K \
    STOPTASKS,${SSTATE_DIR},1G,100K \
    STOPTASKS,/tmp,100M,100K \
    ABORT,${TMPDIR},100M,1K \
    ABORT,${DL_DIR},100M,1K \
    ABORT,${SSTATE_DIR},100M,1K \
    ABORT,/tmp,10M,1K"

CONF_VERSION = "2"
```
